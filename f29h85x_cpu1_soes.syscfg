/**
 * @cliArgs --board "/boards/HSEC180ADAPEVM-F29H85X-SOM" --context "CPU1" --product "MCU_SDK_F29H85x@1.02.01.00"
 * @versions {"tool":"1.26.0+4407"}
 */

/**
 * Import the modules used in this configuration.
 */
const led       = scripting.addModule("/driverlib/board_components/led", {}, false);
const led1      = led.addInstance();
const led2      = led.addInstance();
const cputimer  = scripting.addModule("/driverlib/cputimer.js", {}, false);
const cputimer1 = cputimer.addInstance();
const gpio      = scripting.addModule("/driverlib/gpio.js", {}, false);
const gpio1     = gpio.addInstance();
const gpio2     = gpio.addInstance();
const jtag      = scripting.addModule("/driverlib/jtag.js");
const uart      = scripting.addModule("/driverlib/uart.js", {}, false);
const uart1     = uart.addInstance();

/**
 * Write custom configuration values to the imported modules.
 */
led1.$name                  = "myBoardLED1";
led1.$hardware              = system.deviceData.board.components.USER_LEDS.subComponents.USER_LED0;
led1.gpio.writeInitialValue = true;

led2.$name                  = "myBoardLED0";
led2.$hardware              = system.deviceData.board.components.USER_LEDS.subComponents.USER_LED1;
led2.gpio.writeInitialValue = true;

const divider4       = system.clockTree["EPWMCLKDIV"];
divider4.divideValue = 1;

const divider15       = system.clockTree["PLL_REFDIV"];
divider15.divideValue = 1;

const multiplier1         = system.clockTree["PLL_IMULT"];
multiplier1.multiplyValue = 40;

const mux7       = system.clockTree["OSCCLKSRCSEL"];
mux7.inputSelect = "INTOSC2";

cputimer1.$name              = "myCPUTIMER0";
cputimer1.timerPeriod        = 200000;
cputimer1.enableInterrupt    = true;
cputimer1.registerInterrupts = true;
cputimer1.periphClock.$name  = "driverlib_perClock1";

gpio1.$name             = "dbg_1";
gpio1.direction         = "GPIO_DIR_MODE_OUT";
gpio1.writeInitialValue = true;
gpio1.gpioPin.$assign   = "hsecDigital.86";

gpio2.$name             = "dbg_2";
gpio2.direction         = "GPIO_DIR_MODE_OUT";
gpio2.writeInitialValue = true;
gpio2.gpioPin.$assign   = "hsecDigital.88";


uart1.$hardware          = system.deviceData.board.components.XDS110_HEADER.subComponents.UART0;
uart1.baudSelect         = "115200";
uart1.$name              = "dbgUART0";
uart1.txQual.$name       = "myGPIOQUAL0";
uart1.rxQual.$name       = "myGPIOQUAL1";
uart1.periphClock.$name  = "driverlib_perClock0";
uart1.periphConfig.$name = "driverlib_perConfig0";

/**
 * Pinmux solution for unlocked pins/peripherals. This ensures that minor changes to the automatic solver in a future
 * version of the tool will not impact the pinmux you originally saw.  These lines can be completely deleted in order to
 * re-solve from scratch.
 */
led1.gpio.gpioPin.$suggestSolution     = "hsecDigital.89";
led2.gpio.gpioPin.$suggestSolution     = "hsecDigital.91";
jtag.JTAG.$suggestSolution             = "JTAG";
jtag.JTAG.tdoPin.$suggestSolution      = "hsecAnalog.6";
jtag.JTAG.tdiPin.$suggestSolution      = "hsecAnalog.8";
uart1.uart.$suggestSolution            = "UARTA";
uart1.uart.uart_txPin.$suggestSolution = "hsecDigital.78";
uart1.uart.uart_rxPin.$suggestSolution = "hsecDigital.76";
